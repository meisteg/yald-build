## layers/meta-yald/conf/distro/yald.conf
```bitbake
require conf/distro/poky.conf

DISTRO = "yald"
DISTRO_NAME = "yald (Yet Another Linux Distro)"

SDK_VENDOR = "-yaldsdk"
TARGET_VENDOR = "-yald"

DISTRO_FEATURES:remove = "alsa bluetooth ext2 pcmcia 3g nfc x11 opengl ptest wayland pulseaudio vulkan sysvinit wifi"

INIT_MANAGER = "systemd"
EFI_PROVIDER = "grub-efi"

INHERIT += "image-buildinfo"

require conf/distro/include/cve-extra-exclusions.inc

# Wrynose default is 6.18.x
# PREFERRED_VERSION_linux-yocto = "6.18%"
```

## layers/meta-yald/conf/machine/yald-x86-64.conf
```bitbake
#@TYPE: Machine
#@NAME: yald x86_64
#@DESCRIPTION: Machine configuration for yald x86_64 (64-bit) PCs and servers.

require conf/machine/include/x86/tune-x86-64-v3.inc
require conf/machine/include/genericx86-common.inc

MACHINEOVERRIDES =. "genericx86-64:"

MACHINE_FEATURES:remove = "alsa"
MACHINE_FEATURES:remove = "wifi"

#For runqemu
QB_SYSTEM_NAME = "qemu-system-x86_64"
QB_MEM = "-m 2G"
QB_OPT_APPEND:append = " -device intel-iommu,intremap=on -device edu"
QB_KERNEL_CMDLINE_APPEND:append = " vfio-pci.ids=1234:11e8"
IMAGE_FSTYPES += "ext4.zst"
```
